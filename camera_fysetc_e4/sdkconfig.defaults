## camera_fysetc_e4/sdkconfig.defaults
```kconfig
# SDK Configuration defaults for FYSETC E4 PTZ Camera Rig
# ESP32 configuration
CONFIG_IDF_TARGET="esp32"

# USB Serial configuration
CONFIG_ESP_CONSOLE_USB_SERIAL_JTAG=y
CONFIG_ESP_CONSOLE_UART_DEFAULT=y

# FreeRTOS configuration
CONFIG_FREERTOS_HZ=1000

# GPIO configuration
CONFIG_GPIO_CTRL_FUNC_IN_IRAM=y

# NVS configuration
CONFIG_NVS_ENCRYPTION=y

# Logger configuration
CONFIG_LOG_DEFAULT_LEVEL_INFO=y
CONFIG_LOG_MAXIMUM_LEVEL_VERBOSE=y

# Partition table configuration for OTA support
CONFIG_PARTITION_TABLE_CUSTOM=y
CONFIG_PARTITION_TABLE_CUSTOM_FILENAME="partitions.csv"
CONFIG_PARTITION_TABLE_FILENAME="partitions.csv"

# Flash size configuration
# Check actual flash size with: idf.py -p COM_PORT flash_id
# Common sizes: 2MB, 4MB, 8MB, 16MB
# Detected: 16MB flash - plenty of space for OTA partitions
CONFIG_ESPTOOLPY_FLASHSIZE_16MB=y
```
